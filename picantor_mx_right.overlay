/*
 * Copyright (c) 2020 Pete Johanson
 *
 * SPDX-License-Identifier: MIT
 */

#include "picantor_mx.dtsi"

&default_transform {
    col-offset = <6>;
};

&five_column_transform {
    col-offset = <6>;
};

&kscan0 {
     compatible = "zmk,kscan-gpio-direct";
    input-gpios 
        =     <&pro_micro 22 (GPIO_ACTIVE_LOW | GPIO_PULL_UP)>
            , <&pro_micro 27 (GPIO_ACTIVE_LOW | GPIO_PULL_UP)>
            , <&pro_micro 28 (GPIO_ACTIVE_LOW | GPIO_PULL_UP)>
            , <&pro_micro 5 (GPIO_ACTIVE_LOW | GPIO_PULL_UP)>
            , <&pro_micro 6 (GPIO_ACTIVE_LOW | GPIO_PULL_UP)>
            , <&pro_micro 7 (GPIO_ACTIVE_LOW | GPIO_PULL_UP)>
            , <&pro_micro 13 (GPIO_ACTIVE_LOW | GPIO_PULL_UP)>
            , <&pro_micro 14 (GPIO_ACTIVE_LOW | GPIO_PULL_UP)>
            , <&pro_micro 15 (GPIO_ACTIVE_LOW | GPIO_PULL_UP)>
            , <&pro_micro 16 (GPIO_ACTIVE_LOW | GPIO_PULL_UP)>
            , <&pro_micro 18 (GPIO_ACTIVE_LOW | GPIO_PULL_UP)>
            , <&pro_micro 19 (GPIO_ACTIVE_LOW | GPIO_PULL_UP)>
            , <&pro_micro 20 (GPIO_ACTIVE_LOW | GPIO_PULL_UP)>
            , <&pro_micro 21 (GPIO_ACTIVE_LOW | GPIO_PULL_UP)>
            , <&pro_micro 26 (GPIO_ACTIVE_LOW | GPIO_PULL_UP)>
            , <&pro_micro 27 (GPIO_ACTIVE_LOW | GPIO_PULL_UP)>
            ;
};
